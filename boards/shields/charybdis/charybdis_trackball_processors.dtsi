/*
 * Copyright (c) 2024 The ZMK Contributors
 * SPDX-License-Identifier: MIT
 * 
 * Common trackball input processor configurations for Charybdis keyboard
 * This file defines the standard processing for snipe, scroll, and move modes
 * 
 * Usage: Include this file and define CHARYBDIS_TRACKBALL_LISTENER macro
 * Example:
 *   #define CHARYBDIS_TRACKBALL_LISTENER snipe { layers = <SNIPING>; input-processors = <&zip_xy_scaler 1 3>; }; scroll { layers = <SCROLL>; input-processors = <&zip_xy_transform (INPUT_TRANSFORM_Y_INVERT)>, <&zip_xy_scaler 1 20>, <&zip_xy_to_scroll_mapper>; }; move { layers = <BASE POINTER>; input-processors = <&zip_xy_scaler 7 6>; };
 */

#include "charybdis_layers.h"
#include <dt-bindings/zmk/input_transform.h>
#include <input/processors.dtsi>

// Single global instance, so these settings apply to every reference below.
/ {
    /*
     * Replaces upstream's &zip_temp_layer. Same job, but it works out which presses
     * belong to AUTO_MOUSE by reading the binding the layer actually carries at that
     * position -- &trans / &none mean "not mine" -- instead of matching the position
     * against an excluded-positions list that had to be edited by hand, and rebuilt,
     * every time a binding moved. See src/input_processor_auto_layer.c.
     *
     * Consequence worth knowing: a bound key now REFRESHES the timeout instead of
     * being merely tolerated, so clicking keeps the layer alive as long as you keep
     * clicking. Transparent keys are ignored entirely and the layer expires on time.
     */
    zip_auto_layer: zip_auto_layer {
        compatible = "zmk,input-processor-auto-layer";
        #input-processor-cells = <2>;

        /* Brushing the ball mid-typing must not raise the layer: the thumb rests right
         * next to it on a Charybdis, and this is what makes the whole thing usable. */
        require-prior-idle-ms = <300>;
    };
};

// Standard trackball processing configuration
// Can be used in both standalone (trackball_listener) and dongle mode (input_split_listener)
//
// Every divisor here is relative to `cpi` in charybdis_right_common.dtsi (1600).
// Effective resolution = cpi * mul / div:
//   move  1600 * 3/4  = 1200    snipe 1600 * 1/6 = 267    scroll 1600 * 1/160 = 10
// move/snipe hold the 4.5x ratio the original cpi=400 setup had, at twice its speed --
// 600 effective was ~5 thumb sweeps to cross a screen. cpi stays high because it buys
// resolution, not speed: the divisors here set the speed, and dividing is lossless
// (input_processor_scaler.c accumulates the remainder) while multiplying is not.
// Scroll is left alone: how fast a page scrolls is its own preference, unrelated to
// pointer speed. If you change cpi, rescale all three or the feel shifts everywhere.
// &zip_auto_layer AUTO_MOUSE 500 is repeated in all three chains on purpose.
// input_listener.c walks these children in declaration order and stops at the first
// whose layer_mask is active (`if (!override->process_next) return 0;`). So while
// SNIPING or SCROLL is held, the `move` chain never runs -- without the processor in
// those chains too, AUTO_MOUSE would time out from under you mid-snipe.
// `move` needs no AUTO_MOUSE in its `layers`: BASE is always active, so it already
// matches as the catch-all.
#define CHARYBDIS_TRACKBALL_PROCESSORS \
    snipe { \
        layers = <SNIPING>; \
        input-processors = <&zip_auto_layer AUTO_MOUSE 500>, <&zip_xy_scaler 1 6>; \
    }; \
    \
    scroll { \
        layers = <SCROLL>; \
        input-processors = <&zip_auto_layer AUTO_MOUSE 500>, <&zip_xy_transform (INPUT_TRANSFORM_Y_INVERT)>, <&zip_xy_scaler 1 160>, <&zip_xy_to_scroll_mapper>; \
    }; \
    \
    move { \
        layers = <BASE POINTER>; \
        input-processors = <&zip_auto_layer AUTO_MOUSE 500>, <&zip_xy_scaler 3 4>; \
    };

