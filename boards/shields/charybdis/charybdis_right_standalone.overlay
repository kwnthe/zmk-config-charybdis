/*
 * Copyright (c) 2024 The ZMK Contributors
 * SPDX-License-Identifier: MIT
 * 
 * Charybdis right keyboard - Standalone mode (acts as central)
 * Processes trackball input locally
 */

#include "charybdis_right_common.dtsi"
#include "charybdis_trackball_processors.dtsi"

/ {
    trackball_listener: trackball_listener {
        compatible = "zmk,input-listener";
        status = "okay";
        device = <&trackball>;

        CHARYBDIS_TRACKBALL_PROCESSORS
    };
};

/*
 * 250Hz sampling instead of 125Hz -- roughly 4ms off the worst-case age of a report.
 * Applied only in standalone, where the radio is contended and the latency is worth
 * the extra power. charybdis_right_common.dtsi is shared with dongle_charybdis_right,
 * so putting it there would have changed the dongle build too.
 */
&trackball {
    force-awake-4ms-mode;
};
