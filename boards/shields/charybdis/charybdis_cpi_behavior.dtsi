/*
 * Copyright (c) 2026 The ZMK Contributors
 * SPDX-License-Identifier: MIT
 *
 * &tb_cpi has to exist in EVERY shield that compiles config/charybdis.keymap -- left
 * half, right half and all the dongles share one keymap file, and a keymap referencing
 * a node the shield never defines is a build error. Only the half holding the sensor
 * fills in `device` (see charybdis_right_common.dtsi); elsewhere the behavior is a
 * harmless no-op.
 */

#pragma once

/ {
    behaviors {
        /*
         * Node name must stay under 9 characters. When the central dispatches a
         * behavior to a peripheral it sends the DEVICE NAME, and the payload field is
         * char behavior_dev[ZMK_SPLIT_RUN_BEHAVIOR_DEV_LEN] with DEV_LEN = 9 --
         * anything longer is truncated and the peripheral finds nothing, silently.
         * This node was `behavior_trackball_cpi`, arrived as "behavior", and did
         * nothing at all in dongle mode, where the trackball is on a peripheral.
         * ZMK's own reset behaviors are named `sysreset` and `bootload` for exactly
         * this reason. The label below is unconstrained; only the node name matters.
         */
        tb_cpi: tbcpi {
            compatible = "zmk,behavior-trackball-cpi";
            #binding-cells = <1>;

            /* Without this, editors render the node name truncated ("or_trackb"). */
            display-name = "CPI";

            /* Keep cpi-default in step with `cpi` on the trackball node. */
            cpi-min = <200>;
            cpi-max = <3200>;
            cpi-step = <200>;
            cpi-default = <1600>;
        };

        /*
         * No node-name limit here: default CENTRAL locality means this never crosses
         * the split, so it is not squeezed into ZMK_SPLIT_RUN_BEHAVIOR_DEV_LEN.
         */
        batt_rpt: batt_rpt {
            compatible = "zmk,behavior-battery-report";
            #binding-cells = <0>;
            display-name = "Battery";
            tap-ms = <12>;
        };
    };
};
