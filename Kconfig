## Kconfig
```kconfig
# Copyright (c) 2026 The ZMK Contributors
# SPDX-License-Identifier: MIT

config ZMK_BEHAVIOR_TRACKBALL_CPI
    bool "Runtime trackball CPI behavior"
    default y
    depends on DT_HAS_ZMK_BEHAVIOR_TRACKBALL_CPI_ENABLED
    help
      Builds &tb_cpi, which retunes the PMW3610's CPI from a key. The dependency is
      generated from the compatible, so this stays off in any build whose devicetree
      has no such node.

config ZMK_BEHAVIOR_TRACKBALL_CPI_INIT_PRIORITY
    int "Runtime trackball CPI behavior init priority"
    default 90
    range 0 99
    depends on ZMK_BEHAVIOR_TRACKBALL_CPI
    help
      POST_KERNEL priority. The `device` phandle makes the sensor a devicetree
      dependency, and Zephyr's init-priority check rejects the build unless this
      behavior initializes after it -- the PMW3610 sits at INPUT_INIT_PRIORITY.
      Referencing the driver's own Kconfig symbol is not an option here: it does not
      exist in the left-half and dongle builds, which instantiate this behavior
      without a sensor. Hence a plain number, chosen to land well after any input
      device while staying inside POST_KERNEL.

config ZMK_INPUT_PROCESSOR_AUTO_LAYER
    bool "Self-maintaining auto-mouse layer processor"
    default y
    depends on DT_HAS_ZMK_INPUT_PROCESSOR_AUTO_LAYER_ENABLED
    help
      Builds &zip_auto_layer, the replacement for upstream's zip_temp_layer that reads
      the keymap to decide which presses belong to the layer rather than matching them
      against an excluded-positions list.

config ZMK_BEHAVIOR_BATTERY_REPORT
    bool "Type the split halves' battery percentages"
    default y
    depends on DT_HAS_ZMK_BEHAVIOR_BATTERY_REPORT_ENABLED
    help
      Builds &batt_rpt. Only useful on the central, which is where the peripheral
      battery levels are cached and where HID output happens, but it instantiates
      everywhere so one keymap builds for every shield.
```

## dts/bindings/behaviors/zmk,behavior-battery-report.yaml
```yaml
# Copyright (c) 2026 The ZMK Contributors
# SPDX-License-Identifier: MIT

description: |
  Types the split halves' battery percentages as text, e.g. "B0 78 B1 64".

  For a dongle wired to the host over USB there is no other way to see them: ZMK
  reports battery only through the BLE GATT Battery Service, and USB HID has no
  battery channel at all. The central does know the levels -- it collects them when
  CONFIG_ZMK_SPLIT_BLE_CENTRAL_BATTERY_LEVEL_FETCHING is set -- so this reads that
  cache and spells it out on the keyboard itself.

  The number after B is the peripheral slot, assigned in connection order and stable
  once both halves are bonded. Learn which is which once.

compatible: "zmk,behavior-battery-report"

include: zero_param.yaml

properties:
  tap-ms:
    type: int
    default: 12
    description: |
      Milliseconds between key events while typing. Each character costs two of these,
      one for press and one for release. Too low and the HID reports coalesce and
      characters go missing; too high and the report takes a visible moment to appear.
```

## dts/bindings/behaviors/zmk,behavior-central-bootloader.yaml
```yaml
# Copyright (c) 2026 The ZMK Contributors
# SPDX-License-Identifier: MIT

description: |
  Reboots the central into its UF2 bootloader.

  ZMK's &bootloader runs with BEHAVIOR_LOCALITY_EVENT_SOURCE, so it always targets the
  half holding the key and can never reach a dongle -- the one board with no keys, and
  so the one whose reset button you otherwise have to reach for.

  Targets whichever board is central at the time: the dongle in dongle mode, the right
  half in standalone. That is the board running the keymap, and the one being reflashed.

compatible: "zmk,behavior-central-bootloader"

include: zero_param.yaml
```

## dts/bindings/behaviors/zmk,behavior-trackball-cpi.yaml
```yaml
# Copyright (c) 2026 The ZMK Contributors
# SPDX-License-Identifier: MIT

description: |
  Changes the trackball sensor's CPI at runtime.

  param1 is either one of the CPI_INC / CPI_DEC / CPI_RESET commands from
  dt-bindings/charybdis/cpi.h, or an absolute CPI value (>= 200).

compatible: "zmk,behavior-trackball-cpi"

include: one_param.yaml

properties:
  device:
    type: phandle
    required: false
    description: |
      The sensor to drive. Optional on purpose: the keymap is shared by every shield,
      but only the half that physically carries the trackball can define this. Where
      it is absent the behavior instantiates and no-ops, which keeps the dongle and
      left-half builds compiling against the same keymap.

  cpi-min:
    type: int
    default: 200
    description: Lower clamp. PMW3610_MIN_CPI.

  cpi-max:
    type: int
    default: 3200
    description: Upper clamp. PMW3610_MAX_CPI.

  cpi-step:
    type: int
    default: 200
    description: |
      Increment for CPI_INC / CPI_DEC. Also the rounding quantum: the driver computes
      the register value as cpi/200 with integer truncation, so anything that is not a
      multiple of this silently rounds down.

  cpi-default:
    type: int
    default: 1600
    description: |
      Startup value and the CPI_RESET target. Must match the `cpi` property on the
      sensor node -- nothing reads it back from the hardware.
```

## dts/bindings/behaviors/zmk,behavior-typing-stats.yaml
```yaml
# Copyright (c) 2026 The ZMK Contributors
# SPDX-License-Identifier: MIT

description: |
  Counts keystrokes and types the totals on press, e.g. "124503 keys 21034 words 62 wpm
  8912 bksp".

  Counts keycodes, not text. "Words" means a space, enter or tab arriving after at least
  one letter -- close enough for prose, misleading for code, and WASD in a game counts
  as letters. Backspaces are counted separately and never subtracted, so the totals stay
  honest about what was pressed rather than guessing at what survived.

  WPM is gross: five keystrokes to a word, divided by active time only. Gaps longer than
  three seconds are treated as pauses and excluded, or a night of idling would flatten
  the average.

  Totals live in NVS and survive reboots and firmware flashes. settings_reset erases
  them -- that partition is what settings_reset exists to wipe, and the nice!nano flash
  map has no spare region. The baseline-* properties are the answer: read the totals out
  before a reset, paste them in here, and counting resumes from there. They apply only
  when NVS comes up empty, so an ordinary flash never double-counts.

compatible: "zmk,behavior-typing-stats"

include: zero_param.yaml

properties:
  tap-ms:
    type: int
    default: 12
    description: Milliseconds between key events while typing the report.

  baseline-keys:
    type: int
    default: 0
    description: Starting total, used only when NVS holds nothing.

  baseline-words:
    type: int
    default: 0

  baseline-bksp:
    type: int
    default: 0

  baseline-active-sec:
    type: int
    default: 0
    description: |
      Starting active time in seconds. Seconds rather than milliseconds because a
      devicetree cell is 32 bits, and milliseconds would overflow after about 50 days
      of typing.
```

## dts/bindings/input_processors/zmk,input-processor-auto-layer.yaml
```yaml
# Copyright (c) 2026 The ZMK Contributors
# SPDX-License-Identifier: MIT

description: |
  Raises a layer on pointer motion and holds it there while you keep using it.

  Like zmk,input-processor-temp-layer, but decides what a key press means by reading
  the binding the target layer actually carries at that position, instead of matching
  the position against a hand-maintained list:

    bound (anything but &trans / &none)  ->  refresh the timeout, the layer persists
    transparent / none                   ->  ignored, the layer keeps expiring

  Nothing to keep in step, so bindings added later from a keymap editor work without
  a firmware rebuild.

  param1 = layer index, param2 = idle timeout in ms.

compatible: "zmk,input-processor-auto-layer"

include: ip_two_param.yaml

properties:
  require-prior-idle-ms:
    type: int
    required: false
    default: 0
    description: |
      Suppress activation for this long after any keystroke, so brushing the ball
      mid-typing cannot raise the layer.
```
